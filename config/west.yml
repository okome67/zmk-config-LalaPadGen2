## config/west.yml
```yaml
manifest:
  remotes:
    - name: zmkfirmware
      url-base: https://github.com/zmkfirmware

    - name: ShiniNet
      url-base: https://github.com/ShiniNet/

    - name: caksoylar
      url-base: https://github.com/caksoylar

    - name: urob
      url-base: https://github.com/urob

    - name: cormoran
      url-base: https://github.com/cormoran

  projects:
    - name: zmk
      remote: cormoran
      revision: main+dya
      import:
        file: app/west.yml

    - name: zephyr
      remote: cormoran
      revision: v4.1.0+zmk-fixes+nrf-half-duplex-uart
      clone-depth: 1
      import:
        name-blocklist:
          - ci-tools
          - hal_altera
          - hal_cypress
          - hal_infineon
          - hal_microchip
          - hal_nxp
          - hal_openisa
          - hal_xtensa
          - hal_st
          - hal_ti
          - loramac-node
          - edtt
          - trusted-firmware-m

    - name: zmk-driver-iqs9151
      remote: ShiniNet
      revision: main

    - name: zmk-easy-charge-indicator
      remote: ShiniNet
      revision: main

    - name: zmk-rgbled-widget
      remote: caksoylar
      revision: v0.3

    - name: zmk-smart-toggle
      remote: caksoylar
      revision: main

    - name: zmk-leader-key
      remote: urob
      revision: v0.3

    - name: zmk-auto-layer
      remote: urob
      revision: v0.3

    - name: zmk-feature-custom-settings
      remote: cormoran
      revision: main

    - name: zmk-feature-fast-keymap
      remote: cormoran
      revision: main

  self:
    path: config
```
